/*
 * Copyright (c) 2020 ZMK Contributors
 *
 * SPDX-License-Identifier: MIT
 */
 
#include "charybdis.dtsi"

&default_transform {
	col-offset = <6>;
};


&kscan0 {
	col-gpios
        = <&gpio1  4 (GPIO_ACTIVE_LOW | GPIO_PULL_UP)>  // col6 in the schematic of charybdis
        , <&gpio0 11 (GPIO_ACTIVE_LOW | GPIO_PULL_UP)>  // col5 in the schematic of charybdis
        , <&gpio1  0 (GPIO_ACTIVE_LOW | GPIO_PULL_UP)>  // col4 in the schematic of charybdis
        , <&gpio0  9 (GPIO_ACTIVE_LOW | GPIO_PULL_UP)>  // col3 in the schematic of charybdis
        , <&gpio0 29 (GPIO_ACTIVE_LOW | GPIO_PULL_UP)>  // col2 in the schematic of charybdis
        , <&gpio0  2 (GPIO_ACTIVE_LOW | GPIO_PULL_UP)>  // col1 in the schematic of charybdis
        ;
};
