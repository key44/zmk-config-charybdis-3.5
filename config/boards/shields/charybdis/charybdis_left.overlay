/*
 * Copyright (c) 2020 ZMK Contributors
 *
 * SPDX-License-Identifier: MIT
 */

#include "charybdis.dtsi"

&kscan0 {
	col-gpios
        = <&gpio0 2 GPIO_ACTIVE_HIGH> // col1 in the schematic
        , <&gpio0 29 GPIO_ACTIVE_HIGH> // col2 in the schematic
        , <&gpio0 9 GPIO_ACTIVE_HIGH> // col3 in the schematic
        , <&gpio1 0 GPIO_ACTIVE_HIGH> // col4 in the schematic
        , <&gpio0 11 GPIO_ACTIVE_HIGH> // col5 in the schematic
        , <&gpio1 4 GPIO_ACTIVE_HIGH> // col6 in the schematic
        ;
};

&left_encoder {
    status = "okay";
};